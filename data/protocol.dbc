VERSION ""

NS_ :

BU_ : ToEngine ToGround

BO_ 256 EngineSignal: 24 ToEngine
    SG_ EngineThrust : 0|16@1+ (0.1,0) [0|1000.0] "lbf" ToGround
    SG_ NitrousWeight : 16|16@1+ (1,0) [0|1000.0] "lbs" ToGround
    SG_ RunTankPressure : 32|16@+ (0.1,0) [0|1000.0] "psi" ToGround
    SG_ CCPressure : 48|16@1+ (0.1,0) [0|1000.0] "psi" ToGround
    SG_ TopCCTemp : 64|16@1+ (0.1,0) [0|1300.0] "F" ToGround
    SG_ BotCCTemp : 80|16@1+ (0.1,0) [0|1300.0] "F" ToGround
    SG_ MCUTimer : 96|32@1+ (0.01,0) [0|42949672.96] "s" ToGround
    SG_ SV11State : 128|4@1+ (1,0) [0|3] "" ToGround
    SG_ SV12State : 132|4@1+ (1,0) [0|3] "" ToGround
    SG_ SV13State : 136|4@1+ (1,0) [0|3] "" ToGround
    SG_ IgnitorState : 140|4@1+ (1,0) [0|3] "" ToGround
    SG_ ArmedStatus : 144|4@1+ (1,0) [0|3] "" ToGround
    SG_ RoutineSequence : 148|4@1+ (1,0) [0|5] "" ToGround
    SG_ ReservedEngine : 152|40@1+ (1,0) [0|1] "" ToGround

BO_ 512 GroundStationSignal: 16 ToGround
    SG_ GroundSV11Toggle : 0|4@1+ (1,0) [0|1] "" ToEngine
    SG_ RunTankSV12Toggle : 4|4@1+ (1,0) [0|1] "" ToEngine
    SG_ GaugeSV13Toggle : 8|4@1+ (1,0) [0|1] "" ToEngine
    SG_ ArmedSelection : 12|4@1+ (1,0) [0|1] "" ToEngine
    SG_ RoutineSelection : 16|4@1+ (1,0) [0|5] "" ToEngine
    SG_ FireDelay : 20|16@1+ (1,0) [0|65535] "ms" ToEngine
    SG_ LoadCellTare : 36|4@1+ (1,0) [0|3] "" ToEngine
    SG_ Reserved : 40|88@1+ (1,0) [0|1] "" ToEngine

CM_ BO_ 256 "The data that's coming from the engine into the ground station";
CM_ BO_ 512 "The signal that's coming from ground station and going to the engine";
